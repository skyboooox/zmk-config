## boards/shields/ssd1681_154/Kconfig.defconfig
```kconfig
# Copyright (c) 2025 The ZMK Contributors
# SPDX-License-Identifier: MIT

if SHIELD_SSD1681_154

config ZMK_DISPLAY
    default y

config ZMK_DISPLAY_STATUS_SCREEN
    default y

config LV_Z_BITS_PER_PIXEL
    default 1

choice LV_COLOR_DEPTH
    default LV_COLOR_DEPTH_1
endchoice

choice ZMK_DISPLAY_WORK_QUEUE
    default ZMK_DISPLAY_WORK_QUEUE_DEDICATED
endchoice

config LV_Z_VDB_SIZE
    default 100

config LV_DPI_DEF
    default 130

endif # SHIELD_SSD1681_154
```

## boards/shields/ssd1681_154/Kconfig.shield
```kconfig
# Copyright (c) 2025 The ZMK Contributors
# SPDX-License-Identifier: MIT

# Shield selection flag. Ensure no whitespace in the shield name.
config SHIELD_SSD1681_154
    def_bool $(shields_list_contains,ssd1681_154)
```
